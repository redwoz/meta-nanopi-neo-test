## conf/layer.conf
```bitbake
# We have a conf directory, append to BBPATH
BBPATH .= ":${LAYERDIR}"

# We have a recipes directory, add to BBFILES
BBFILES += "${LAYERDIR}/recipes-*/*/*.bb \
            ${LAYERDIR}/recipes-*/*/*.bbappend"

BBFILE_COLLECTIONS += "meta-nanopi-neo-test"
BBFILE_PATTERN_meta-nanopi-neo-test := "^${LAYERDIR}/"
BBFILE_PRIORITY_meta-nanopi-neo-test = "8"
```
